## Kconfig
```kconfig
if MACH_XIAOMI_SDM845
source "techpack/mi845/amplifier/Kconfig"
source "techpack/mi845/gps/Kconfig"
source "techpack/mi845/halls/Kconfig"
source "techpack/mi845/input/Kconfig"
source "techpack/mi845/leds/Kconfig"
source "techpack/mi845/power/Kconfig"
endif # MACH_XIAOMI_SDM845
```

## amplifier/Kconfig
```kconfig
menu "Audio Power Amplifier"
	depends on SND_SOC

config MFD_SPK_ID
	tristate "Speaker ID platform driver"
	depends on I2C

config SND_SOC_TAS2559_MAINLINE
	tristate "Texas Instruments TAS2559 speaker amplifier from sdm845 mainline"
	depends on I2C

config SND_SOC_TAS2559
	tristate "Texas Instruments TAS2559 speaker amplifier"
	depends on I2C

config SND_SOC_TAS2557
	tristate "Texas Instruments TAS2557 speaker amplifier"
	depends on I2C

source "techpack/mi845/amplifier/elliptic/Kconfig"

endmenu
```

## amplifier/elliptic/Kconfig
```kconfig
#
# ELLIPTIC driver configuration
#

config SND_ELLIPTIC
	tristate "Providing Interface to UPS data"
	depends on I2C
```

## input/Kconfig
```kconfig
menu "Input device support"
	depends on !UML

source "techpack/mi845/input/fingerprint/Kconfig"

endmenu

source "techpack/mi845/input/touchscreen/Kconfig"
```

## input/touchscreen/Kconfig
```kconfig
menu "Touchscreen"
	depends on INPUT_TOUCHSCREEN

config TOUCHSCREEN_EDT_FT5X06_MI845
	tristate "EDT FocalTech FT5x06 I2C Touchscreen support"
	depends on I2C
	select REGMAP_I2C
	help
	  Say Y here if you have an EDT "Polytouch" touchscreen based
	  on the FocalTech FT5x06 family of controllers connected to
	  your system.

	  If unsure, say N.

	  To compile this driver as a module, choose M here: the
	  module will be called edt-ft5x06.

source "techpack/mi845/input/touchscreen/focaltech_touch_mi/Kconfig"
source "techpack/mi845/input/touchscreen/nt36xxx/Kconfig"

endmenu
```

## input/touchscreen/atmel_mxt_ts/Kconfig
```kconfig
config TOUCHSCREEN_ATMEL_MXT_MI
	bool "Atmel maXTouch Touchscreen driver"
	depends on I2C
	help
	  Say Y here if you have a press ic ndt.
```

## input/touchscreen/focaltech_touch_mi_sm8250/Kconfig
```kconfig
#
# Focaltech Touchscreen driver configuration
#

config TOUCHSCREEN_FTS_MI_SM8250
	bool "Focaltech Touchscreen"
	depends on I2C
	default n
	help
	  Say Y here if you have Focaltech touch panel.
	  If unsure, say N.

config TOUCHSCREEN_FTS_FOD
	bool "Focaltech Touchscreen Fod func"
	depends on TOUCHSCREEN_FTS_MI_SM8250
	default n
	help
	  Say Y here if you support fod function.
	  If unsure, say N.
```

## input/touchscreen/ndt/Kconfig
```kconfig
config INPUT_PRESS_NDT
	bool "ndt"
	depends on I2C
	help
	  Say Y here if you have a press ic ndt.

config INPUT_PRESS_NDT_F60
	bool "Ndt F60 Press Driver"
	depends on INPUT_PRESS_NDT
	help
	  Say Y here if you have a press ic ndt.

config INPUT_PRESS_NDT_M65
	bool "Ndt M65 Press Driver"
	depends on INPUT_PRESS_NDT
	help
	  Say Y here if you have a press ic ndt.
```

## input/touchscreen/nt36xxx_los/Kconfig
```kconfig
#
# Novatek NT36xxx touchscreen driver configuration
#
config TOUCHSCREEN_NT36XXX_LOS
	bool "Novatek NT36XXX_LOS"
	default y
	help
	  Say Y here if you have a Novatek NT36xxx touchscreen connected
	  to your system.

	  If unsure, say N.
```
